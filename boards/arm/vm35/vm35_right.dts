/dts-v1/;
#include "vm35.dtsi"

/*
 * Split right half — peripheral role (set in Kconfig.defconfig).
 *
 * Same physical 7x5 board as the left, but its keys must occupy the
 * second block of the combined keymap. Override the transform so this
 * half's local (row,col) maps to positions 35..69; the left (central)
 * keeps 0..34. The central then carries a 70-key split keymap.
 */

&default_transform {
	map = <
		RC(0,5) RC(0,6) RC(0,7) RC(0,8) RC(0,9)
		RC(1,5) RC(1,6) RC(1,7) RC(1,8) RC(1,9)
		RC(2,5) RC(2,6) RC(2,7) RC(2,8) RC(2,9)
		RC(3,5) RC(3,6) RC(3,7) RC(3,8) RC(3,9)
		RC(4,5) RC(4,6) RC(4,7) RC(4,8) RC(4,9)
		RC(5,5) RC(5,6) RC(5,7) RC(5,8) RC(5,9)
		RC(6,5) RC(6,6) RC(6,7) RC(6,8) RC(6,9)
	>;
	columns = <10>;
};
