## config/boards/arm/vm35/Kconfig.board
```kconfig
config BOARD_VM35
	bool "VM35 (standalone macropad)"
	depends on SOC_NRF52840_QIAA

config BOARD_VM35_LEFT
	bool "VM35 left half (split central)"
	depends on SOC_NRF52840_QIAA

config BOARD_VM35_RIGHT
	bool "VM35 right half (split peripheral)"
	depends on SOC_NRF52840_QIAA
```

## config/boards/arm/vm35/Kconfig.defconfig
```kconfig
if BOARD_VM35 || BOARD_VM35_LEFT || BOARD_VM35_RIGHT

config ZMK_KEYBOARD_NAME
	default "VM35"

config BT_CTLR
	default BT

config ZMK_BLE
	default y

config ZMK_USB
	default y

endif

if BOARD_VM35_LEFT

config ZMK_SPLIT
	default y

config ZMK_SPLIT_ROLE_CENTRAL
	default y

endif

if BOARD_VM35_RIGHT

config ZMK_SPLIT
	default y

endif
```

## config/boards/arm/vm35/vm35_left_defconfig
```kconfig
CONFIG_SOC_SERIES_NRF52X=y
CONFIG_SOC_NRF52840_QIAA=y
CONFIG_BOARD_VM35_LEFT=y

CONFIG_ARM_MPU=y
CONFIG_HW_STACK_PROTECTION=y

# E73-2G4M08S1C has an onboard 32.768 kHz crystal
CONFIG_CLOCK_CONTROL_NRF_K32SRC_XTAL=y
CONFIG_CLOCK_CONTROL_NRF_K32SRC_20PPM=y

CONFIG_GPIO=y

# Deep sleep support
CONFIG_PM_DEVICE=y

CONFIG_USE_DT_CODE_PARTITION=y
CONFIG_MPU_ALLOW_FLASH_WRITE=y
CONFIG_NVS=y
CONFIG_SETTINGS_NVS=y
CONFIG_FLASH=y
CONFIG_FLASH_PAGE_LAYOUT=y
CONFIG_FLASH_MAP=y

CONFIG_BUILD_OUTPUT_UF2=y
```

## config/boards/vm/vm35/board.yml
```yaml
board:
  name: vm35
  full_name: VM35 macropad / split half
  vendor: vm
  socs:
    - name: nrf52840
```
