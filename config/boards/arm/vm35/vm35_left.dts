/dts-v1/;
#include "vm35.dtsi"

/*
 * Split left half — central role (set in Kconfig.defconfig).
 *
 * Keeps positions 0..34 from the shared transform, but the combined
 * keymap spans 70 keys (left 0..34, right 35..69). Widen the transform
 * to 10 columns so the central knows the full keymap size.
 */

&default_transform {
	columns = <10>;
};
